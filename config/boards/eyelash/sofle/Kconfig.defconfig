## config/boards/eyelash/sofle/Kconfig.defconfig
```kconfig
# Copyright (c) 2024 The ZMK Contributors
# SPDX-License-Identifier: MIT

if BOARD_SOFLE_LEFT

config ZMK_KEYBOARD_NAME
    default "Sofle"

config ZMK_SPLIT_ROLE_CENTRAL
    default y

endif

if BOARD_SOFLE_LEFT || BOARD_SOFLE_RIGHT

config ZMK_SPLIT
    default y

config BT_CTLR
    default BT

if USB

config USB_NRFX
    default y

config USB_DEVICE_STACK
    default y

endif

if ZMK_DISPLAY

config I2C
    default y

config SSD1306
    default y

choice ZMK_DISPLAY_WORK_QUEUE
    default ZMK_DISPLAY_WORK_QUEUE_DEDICATED
endchoice

endif

if LVGL

config LV_Z_VDB_SIZE
    default 64

config LV_DPI_DEF
    default 148

config LV_Z_BITS_PER_PIXEL
    default 1

choice LV_COLOR_DEPTH
    default LV_COLOR_DEPTH_1
endchoice

endif

if ZMK_BACKLIGHT

config PWM
    default y

config LED_PWM
    default y

endif

endif
```

## config/boards/eyelash/sofle/board.yml
```yaml
boards:
  - name: sofle_left
    vendor: eyelash
    revision:
      format: major.minor.patch
      default: "1.0.0"
      exact: false
      revisions:
        - name: "1.0.0"
    socs:
      - name: nrf52840
        variants:
          - name: zmk
  - name: sofle_right
    vendor: eyelash
    revision:
      format: major.minor.patch
      default: "1.0.0"
      exact: false
      revisions:
        - name: "1.0.0"
    socs:
      - name: nrf52840
        variants:
          - name: zmk
```

## config/boards/eyelash/sofle/sofle_left_nrf52840_zmk_defconfig
```kconfig
# Copyright (c) 2022 Darryl deHaan
# SPDX-License-Identifier: MIT

# Enable MPU
CONFIG_ARM_MPU=y

# Enable GPIO
CONFIG_GPIO=y

# Use pinctrl
CONFIG_PINCTRL=y

# Enable SPI for underglow and display
CONFIG_SPI=y

# Enable PWM for backlight
CONFIG_PWM=y

# Code partition and UF2
CONFIG_USE_DT_CODE_PARTITION=y
CONFIG_BUILD_OUTPUT_UF2=y

# Flash support for BLE bonding storage
CONFIG_MPU_ALLOW_FLASH_WRITE=y
CONFIG_NVS=y
CONFIG_SETTINGS_NVS=y
CONFIG_FLASH=y
CONFIG_FLASH_PAGE_LAYOUT=y
CONFIG_FLASH_MAP=y

# 32kHz crystal
CONFIG_CLOCK_CONTROL_NRF_K32SRC_XTAL=y
CONFIG_CLOCK_CONTROL_NRF_K32SRC_30PPM=y

# ZMK features
CONFIG_ZMK_USB=y
CONFIG_ZMK_BLE=y
CONFIG_ZMK_SLEEP=y

# Display
CONFIG_ZMK_DISPLAY=y
CONFIG_ZMK_DISPLAY_WORK_QUEUE_DEDICATED=y

# LVGL settings for nice_view
CONFIG_LV_Z_VDB_SIZE=64
CONFIG_LV_DPI_DEF=148
CONFIG_LV_Z_BITS_PER_PIXEL=1
CONFIG_LV_COLOR_DEPTH_1=y

# External power
CONFIG_ZMK_EXT_POWER=y

# BLE settings
CONFIG_BT_CTLR_TX_PWR_PLUS_8=y
CONFIG_ZMK_BLE_PASSKEY_ENTRY=n
CONFIG_ZMK_BLE_CLEAR_BONDS_ON_START=n

# HID settings
CONFIG_ZMK_HID_REPORT_TYPE_NKRO=n

# EC11 encoder
CONFIG_EC11=y
CONFIG_EC11_TRIGGER_GLOBAL_THREAD=y

# Pointing/mouse
CONFIG_ZMK_POINTING=y

# Macros
CONFIG_ZMK_MACRO_DEFAULT_WAIT_MS=10
CONFIG_ZMK_MACRO_DEFAULT_TAP_MS=20

# Backlight
CONFIG_ZMK_BACKLIGHT=y
CONFIG_ZMK_BACKLIGHT_BRT_START=100
CONFIG_ZMK_BACKLIGHT_ON_START=y
CONFIG_ZMK_BACKLIGHT_AUTO_OFF_IDLE=n

# Debounce
CONFIG_ZMK_KSCAN_DEBOUNCE_PRESS_MS=8
CONFIG_ZMK_KSCAN_DEBOUNCE_RELEASE_MS=8
```

## config/boards/eyelash/sofle/sofle_right_nrf52840_zmk_defconfig
```kconfig
# Copyright (c) 2024 The ZMK Contributors
# SPDX-License-Identifier: MIT

# Enable MPU
CONFIG_ARM_MPU=y

# Enable GPIO
CONFIG_GPIO=y

# Use pinctrl
CONFIG_PINCTRL=y

# Enable SPI for underglow and display
CONFIG_SPI=y

# Enable PWM for backlight
CONFIG_PWM=y

# Code partition and UF2
CONFIG_USE_DT_CODE_PARTITION=y
CONFIG_BUILD_OUTPUT_UF2=y

# Flash support for BLE bonding storage
CONFIG_MPU_ALLOW_FLASH_WRITE=y
CONFIG_NVS=y
CONFIG_SETTINGS_NVS=y
CONFIG_FLASH=y
CONFIG_FLASH_PAGE_LAYOUT=y
CONFIG_FLASH_MAP=y

# 32kHz crystal
CONFIG_CLOCK_CONTROL_NRF_K32SRC_XTAL=y
CONFIG_CLOCK_CONTROL_NRF_K32SRC_30PPM=y

# ZMK features - no USB on peripheral
CONFIG_ZMK_USB=n
CONFIG_ZMK_BLE=y

# Display
CONFIG_ZMK_DISPLAY=y
CONFIG_ZMK_DISPLAY_WORK_QUEUE_DEDICATED=y

# LVGL settings for nice_view
CONFIG_LV_Z_VDB_SIZE=64
CONFIG_LV_DPI_DEF=148
CONFIG_LV_Z_BITS_PER_PIXEL=1
CONFIG_LV_COLOR_DEPTH_1=y

# External power
CONFIG_ZMK_EXT_POWER=y
```
